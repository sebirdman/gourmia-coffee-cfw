## sdkconfig.defaults
```kconfig
CONFIG_ESPTOOLPY_PORT="/dev/cu.SLAB_USBtoUART"

# flashmode
CONFIG_FLASHMODE_QIO=
CONFIG_FLASHMODE_DOUT=y
CONFIG_ESPTOOLPY_FLASHMODE="dout"
CONFIG_SPI_FLASH_MODE=0x3

# flash freq
CONFIG_ESPTOOLPY_FLASHFREQ_80M=y
CONFIG_ESPTOOLPY_FLASHFREQ_40M=
CONFIG_ESPTOOLPY_FLASHFREQ="80m"
CONFIG_SPI_FLASH_FREQ=0xf

# flash size
CONFIG_ESPTOOLPY_FLASHSIZE_4MB=y
CONFIG_ESPTOOLPY_FLASHSIZE="4MB
CONFIG_SPI_FLASH_SIZE=0x400000

# logs
CONFIG_LOG_DEFAULT_LEVEL_WARN=y
```
